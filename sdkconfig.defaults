## sdkconfig.defaults
```kconfig
# Flash size (2MB detected on your board)
CONFIG_ESPTOOLPY_FLASHSIZE_2MB=y

# WiFi
CONFIG_ESP_WIFI_NVS_ENABLED=y

# HTTP Server
CONFIG_HTTPD_MAX_REQ_HDR_LEN=1024
CONFIG_HTTPD_MAX_URI_LEN=512

# LWIP (for DNS server socket)
CONFIG_LWIP_SO_RCVTIMEO=y
```
